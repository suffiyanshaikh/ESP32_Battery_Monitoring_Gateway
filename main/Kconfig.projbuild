## main/Kconfig.projbuild
```kconfig
menu "Device Configuration"

    config ESP_WIFI_SSID
        string "WiFi SSID"
        default "myssid"
        help
            SSID (network name) for the example to connect to.

    config ESP_WIFI_PASSWORD
        string "WiFi Password"
        default "mypassword"
        help
            WiFi password (WPA or WPA2) for the example to use.


    config ESP_MQTT_URL
        string  "Broker URL"
        default "mqtt://test.mosquitto.org"
        help
        URL of the broker to connect to    

    config ESP_MQTT_USERNAME
        string "Username"
        default "username"
        help
        username if broker is secure

    config ESP_MQTT_PASSWORD
        string "Password"
        default "password"
        help
        username if broker is secure
   
endmenu
```
